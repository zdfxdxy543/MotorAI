/**
 * These arguments were used when this file was generated. They will be automatically applied on subsequent loads
 * via the GUI or CLI. Run CLI with '--help' for additional information on how to override these arguments.
 * @cliArgs --device "F2837xS" --part "F2837xS_100PTP" --package "F2837xS_100PTP" --context "system" --product "C2000WARE@5.03.00.00"
 * @v2CliArgs --device "TMS320F28377S" --package "100PTP" --context "system" --product "C2000WARE@5.03.00.00"
 * @versions {"tool":"1.21.0+3721"}
 */

/**
 * Import the modules used in this configuration.
 */
const device_support = scripting.addModule("/driverlib/device_support.js");
