/**
 * These arguments were used when this file was generated. They will be automatically applied on subsequent loads
 * via the GUI or CLI. Run CLI with '--help' for additional information on how to override these arguments.
 * @cliArgs --board "/boards/LAUNCHXL_F28P55X" --device "F28P55x" --part "F28P55x_100PZ" --package "100PZ" --context "system" --product "C2000WARE@5.03.00.00"
 * @v2CliArgs --board "/boards/LAUNCHXL_F28P55X" --device "TMS320F28P550SG" --package "100PZ" --variant "TMS320F28P550SG8" --context "system" --product "C2000WARE@5.03.00.00"
 * @versions {"tool":"1.22.0+3893"}
 */

/**
 * Import the modules used in this configuration.
 */
const device_support = scripting.addModule("/driverlib/device_support.js");
